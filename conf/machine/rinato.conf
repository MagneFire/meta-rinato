## conf/machine/rinato.conf
```bitbake
#@TYPE: Machine
#@NAME: Huawei Watch
#@DESCRIPTION: Machine configuration for the Huawei Watch

require conf/machine/include/arm/armv7a/tune-cortexa7.inc
#require conf/machine/include/hybris-watch.inc
MACHINE_FEATURES = "alsa bluetooth usbgadget usbhost ext2"

SERIAL_CONSOLE = "115200 ttyHSL0"

#PREFERRED_PROVIDER_virtual/mesa = "libhybris"
#PREFERRED_PROVIDER_virtual/egl = "libhybris"
#PREFERRED_PROVIDER_virtual/libgles1 = "libhybris"
#PREFERRED_PROVIDER_virtual/libgles2 = "libhybris"

#PREFERRED_PROVIDER_virtual/android-headers = "android"
#PREFERRED_PROVIDER_virtual/android-system-image = "android"

#KERNEL_IMAGETYPE = "zImage-dtb"
KERNEL_IMAGETYPE = "zImage"
IMAGE_FSTYPES += "ext4"
IMAGE_ROOTFS_ALIGNMENT="4"

IMAGE_INSTALL += "android-tools-adbd android-system firmwared"

DEFAULTTUNE = "armv7vehf-neon"

MACHINE_DISPLAY_ROUND = "true"
MACHINE_HAS_WLAN = "true"
MACHINE_HAS_SPEAKER = "true"

PREFERRED_PROVIDER_virtual/android-system-image = "android"
PREFERRED_VERSION_android = "marshmallow"

PREFERRED_PROVIDER_virtual/kernel = "linux-rinato"
PREFERRED_VERSION_linux = "3.10+marshmallow"

IMAGE_INSTALL += "msm-fb-refresher brcm-patchram-plus underclock asteroid-hrm"
```
